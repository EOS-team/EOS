## src/RROS/kernel/Kconfig.dovetail
```kconfig
# DOVETAIL dual-kernel interface
config HAVE_DOVETAIL
	bool

# Selecting ARCH_WANT_IRQS_OFF_ACTIVATE_MM in this generic Kconfig
# portion is ugly, but the whole ARCH_WANT_IRQS_OFF_ACTIVATE_MM logic
# is a temporary kludge which is meant to disappear anyway. See
# the related comments in exec_mmap() for details.
config DOVETAIL
	bool "Dovetail interface"
	depends on HAVE_DOVETAIL
	select IRQ_PIPELINE
	select ARCH_WANT_IRQS_OFF_ACTIVATE_MM
	default n
	help
	  Activate this option if you want to enable the interface for
	  running a secondary kernel side-by-side with Linux (aka
	  "dual kernel" configuration).
```

## src/RROS/kernel/Kconfig.rros
```kconfig
# Rros real-time core
config HAVE_ARCH_RROS
	bool

menuconfig Rros
	bool "BUPT real-time core"
	depends on HAVE_ARCH_RROS
	select DOVETAIL
	select DEVTMPFS
	help

	  The Rros core is a real-time component of the Linux kernel,
	  which delivers very short and bounded response time to
	  interrupt and task events.  Rros runs asynchronously to the
	  common kernel services, on the high-priority, out-of-band
	  stage managed by the Dovetail layer.

if Rros

source "kernel/rros/Kconfig"

if WARN_CPUFREQ_GOVERNOR
comment "WARNING! CPU_FREQ governors other than 'performance'"
comment "or 'powersave' may significantly increase latency"
comment "on this platform during the frequency transitions."
endif

endif
```

## src/RROS/kernel/rros/Kconfig
```kconfig
# SPDX-License-Identifier: GPL-2.0-only

config RROS_OOB_NET
        bool "Out-of-band networking (EXPERIMENTAL)"
	default n
	select NET_OOB
	select NET_SCHED
	select NET_SCH_OOB
	select INET
	select VLAN_8021Q
	help
	This option enables preliminary networking support for Rros.
```
